## meta-mybsp/conf/layer.conf
```bitbake
BBPATH .= ":${LAYERDIR}"

BBFILES += "${LAYERDIR}/recipes-*/*/*.bb \
            ${LAYERDIR}/recipes-*/*/*.bbappend"

BBFILE_COLLECTIONS += "mybsp"
BBFILE_PATTERN_mybsp = "^${LAYERDIR}/"
BBFILE_PRIORITY_mybsp = "9"

LAYERSERIES_COMPAT_mybsp = "kirkstone"
```

## meta-mydistro/conf/layer.conf
```bitbake
BBPATH .= ":${LAYERDIR}"

BBFILES += "${LAYERDIR}/recipes-*/*/*.bb \
            ${LAYERDIR}/recipes-*/*/*.bbappend"

BBFILE_COLLECTIONS += "mydistro"
BBFILE_PATTERN_mydistro = "^${LAYERDIR}/"
BBFILE_PRIORITY_mydistro = "10"

LAYERSERIES_COMPAT_mydistro = "kirkstone"
```
